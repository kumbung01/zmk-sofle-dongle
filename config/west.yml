## config/west.yml
```yaml
manifest:
  remotes:
    - name: zmkfirmware
      url-base: https://github.com/zmkfirmware
    - name: kumbung01
      url-base: https://github.com/kumbung01
    - name: nrfconnect
      url-base: https://github.com/nrfconnect
  projects:
    # - name: zmk-behivior-custom-caps-word
    #   remote: kumbung01
    #   revision: main
    - name: zmk
      remote: zmkfirmware
      revision: main
      import: app/west.yml
    - name: zmk-feature-split-esb
      remote: kumbung01
      revision: main
    - name: sdk-nrf
      remote: kumbung01
      revision: v3.1-branch+zmk-fixes
      path: nrf
    - name: nrfxlib
      remote: nrfconnect
      revision: v3.1-branch
      repo-path: sdk-nrfxlib
      path: nrfxlib
    - name: prospector-zmk-module                 # <--- and these
      remote: kumbung01                          # <---
      revision: feat/new-status-screens           # <---
  self:
    path: config
```
